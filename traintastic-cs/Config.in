## traintastic-cs/Config.in
```kconfig
source "$BR2_EXTERNAL_TRAINTASTIC_CS_PATH/package/traintastic/traintastic-client/Config.in"
source "$BR2_EXTERNAL_TRAINTASTIC_CS_PATH/package/traintastic/traintastic-data/Config.in"
source "$BR2_EXTERNAL_TRAINTASTIC_CS_PATH/package/traintastic/traintastic-server/Config.in"
```

## traintastic-cs/defconfig/traintastic_cs_rpi4_defconfig
```kconfig
BR2_aarch64=y
BR2_cortex_a72=y
BR2_ARM_FPU_VFPV4=y
BR2_PACKAGE_HOST_LINUX_HEADERS_CUSTOM_6_1=y
BR2_TOOLCHAIN_BUILDROOT_CXX=y
BR2_GLOBAL_PATCH_DIR="board/raspberrypi/patches"
BR2_DOWNLOAD_FORCE_CHECK_HASHES=y
BR2_SYSTEM_DHCP="eth0"
BR2_ROOTFS_POST_BUILD_SCRIPT="board/raspberrypi4-64/post-build.sh"
BR2_ROOTFS_POST_IMAGE_SCRIPT="board/raspberrypi4-64/post-image.sh"
BR2_LINUX_KERNEL=y
BR2_LINUX_KERNEL_CUSTOM_TARBALL=y
BR2_LINUX_KERNEL_CUSTOM_TARBALL_LOCATION="$(call github,raspberrypi,linux,17f135b742c4edb340afb365873c3a574f7e16cb)/linux-17f135b742c4edb340afb365873c3a574f7e16cb.tar.gz"
BR2_LINUX_KERNEL_DEFCONFIG="bcm2711"
BR2_LINUX_KERNEL_DTS_SUPPORT=y
BR2_LINUX_KERNEL_INTREE_DTS_NAME="broadcom/bcm2711-rpi-4-b"
BR2_LINUX_KERNEL_NEEDS_HOST_OPENSSL=y
BR2_PACKAGE_BUSYBOX_SHOW_OTHERS=y
BR2_PACKAGE_XZ=y
BR2_PACKAGE_QT5=y
BR2_PACKAGE_QT5BASE_WIDGETS=y
BR2_PACKAGE_QT5BASE_GIF=y
BR2_PACKAGE_QT5BASE_JPEG=y
BR2_PACKAGE_QT5BASE_PNG=y
BR2_PACKAGE_QT5SVG=y
BR2_PACKAGE_RPI_FIRMWARE=y
BR2_PACKAGE_RPI_FIRMWARE_VARIANT_PI4=y
BR2_PACKAGE_RPI_FIRMWARE_CONFIG_FILE="board/raspberrypi4-64/config_4_64bit.txt"
BR2_PACKAGE_LUA=y
BR2_PACKAGE_LIBB2=y
BR2_PACKAGE_DOUBLE_CONVERSION=y
BR2_PACKAGE_KMOD=y
BR2_PACKAGE_KMOD_TOOLS=y
BR2_TARGET_ROOTFS_EXT2=y
BR2_TARGET_ROOTFS_EXT2_4=y
BR2_TARGET_ROOTFS_EXT2_SIZE="120M"
# BR2_TARGET_ROOTFS_TAR is not set
BR2_PACKAGE_HOST_DOSFSTOOLS=y
BR2_PACKAGE_HOST_GENIMAGE=y
BR2_PACKAGE_HOST_KMOD_XZ=y
BR2_PACKAGE_HOST_MTOOLS=y
BR2_PACKAGE_TRAINTASTIC_CLIENT=y
BR2_PACKAGE_TRAINTASTIC_SERVER=y
```

## traintastic-cs/package/traintastic/traintastic-client/Config.in
```kconfig
config BR2_PACKAGE_TRAINTASTIC_CLIENT
	bool "traintastic-client"
	depends on BR2_PACKAGE_QT5 || BR2_PACKAGE_QT6
	select BR2_PACKAGE_QT5BASE_WIDGETS if BR_PACKAGE_QT5
	select BR2_PACKAGE_QT5BASE_GIF if BR_PACKAGE_QT5
	select BR2_PACKAGE_QT5BASE_JPEG if BR_PACKAGE_QT5
	select BR2_PACKAGE_QT5BASE_PNG if BR_PACKAGE_QT5
	select BR2_PACKAGE_QT5SVG if BR_PACKAGE_QT5
	select BR2_PACKAGE_TRAINTASTIC_DATA
	help
	  Traintastic client application.

	  https://traintastic.org

comment "traintastic-client needs Qt5 or Qt6"
	depends on BR2_INSTALL_LIBSTDCPP
	depends on BR2_TOOLCHAIN_HAS_THREADS
	depends on !BR2_PACKAGE_QT5 || !BR2_PACKAGE_QT6
```

## traintastic-cs/package/traintastic/traintastic-data/Config.in
```kconfig
config BR2_PACKAGE_TRAINTASTIC_DATA
	bool "traintastic-data"
	help
	  Traintastic data.

	  https://traintastic.org
```

## traintastic-cs/package/traintastic/traintastic-server/Config.in
```kconfig
config BR2_PACKAGE_TRAINTASTIC_SERVER
	bool "traintastic-server"
	depends on BR2_PACKAGE_LUA_5_4
	select BR2_PACKAGE_BOOST
	select BR2_PACKAGE_BOOST_PROGRAM_OPTIONS
	select BR2_PACKAGE_ZLIB
	select BR2_PACKAGE_LIBARCHIVE
	select BR2_PACKAGE_TRAINTASTIC_DATA
	help
	  Traintastic server application.

	  https://traintastic.org

comment "traintastic-server needs Lua 5.4"
	depends on !BR2_PACKAGE_LUA_5_4
```
